## drivers/input/fingerprint/Kconfig
```kconfig
#
#Fingerprint
#
menu "Fingerprint support"
	depends on INPUT

config MTK_FINGERPRINT_SUPPORT
	bool "Mediatek Fingerprint"
	default n
	---help---
	Fingerprint mtk driver enable/disable in the kernel.
	Say Y here if you want to use mediatek fingerprint driver,
	fingerprint driver will support fingerprint function
if MTK_FINGERPRINT_SELECT = "GF3258"
config GF3258_FINGERPRINT
	bool "Goodix Fingerprint"
	default y
        ---help---
	Goodix Fingerprint chip GF316M/GF318M/GF3118M/GF518M/GF5118M/GF516M/GF816M/GF3208/GF3206/GF3266/GF3288/GF5206/GF5216/GF5208 TEE driver
endif
if MTK_FINGERPRINT_SELECT = "GF3658"
config GF3658_FINGERPRINT
	bool "Goodix Fingerprint"
	default y
        ---help---
	Goodix Fingerprint chip GF316M/GF318M/GF3118M/GF518M/GF5118M/GF516M/GF816M/GF3208/GF3206/GF3266/GF3288/GF5206/GF5216/GF5208 TEE driver
endif
if MTK_FINGERPRINT_SUPPORT
config MTK_FINGERPRINT_SELECT
	string "sensor type"
	default "GF318M"


if MTK_FINGERPRINT_SELECT = "FPC1028"
config FPC_REE_FINGERPRINT
	bool "FPC ree Fingerprint"
	default y
	---help---
	FPC ree fingerprint FPC's 102x/104x device.
endif
if MTK_FINGERPRINT_SELECT = "FPC1145"
config FPC_FINGERPRINT
	bool "FPC Fingerprint"
	default y
	---help---
	FPC fingerprint FPC's 102x/104x device.
endif

if MTK_FINGERPRINT_SELECT = "GF318M" ||  MTK_FINGERPRINT_SELECT = "GF5216"
config GOODIX_FINGERPRINT
	bool "Goodix Fingerprint"
	default y
	---help---
	Goodix Fingerprint chip GF316M/GF318M/GF3118M/GF518M/GF5118M/GF516M/GF816M/GF3208/GF3206/GF3266/GF3288/GF5206/GF5216/GF5208 TEE driver

config GOODIX_SENSOR_TYPE
	string "SENSOR_TYPE"
	default "GF5216"
	---help---
	Must input sensor type, or default is GF316M GF318M GF3118M GF518M GF5118M GF516M GF816M GF3208 GF3206 GF3266 GF3288 GF5206 GF5216 GF5208
endif
endif
if MTK_FINGERPRINT_SELECT = "MICROARRAY"
config FINGERPRINT_MICROARRAY_FP
	bool "MICROARRAY Fingerprint"
	default y
	---help---
	Microarray fingerprint.
endif
if MTK_FINGERPRINT_SELECT = "BLESTECH"
config FINGERPRINT_BLESTECH
	bool "BLESTECH Fingerprint"
	default y
	---help---
	BLESTECH fingerprint.
endif
if MTK_FINGERPRINT_SELECT = "SUNWAVE_FP"
config MTK_FINGERPRINT_SUNWAVECORP
	bool "SUNWAVECORP Fingerprint"
	default y
	---help---
	SUNWAVECORP fingerprint.
endif
if MTK_FINGERPRINT_SELECT = "SUNWAVE_TEE"
config FINGERPRINT_SUNWAVE_FP_TEE
     bool "SUNWAVE_FP_TEE Fingerprint"
     default y
     ---help---
     SUNWAVE_FP_TEE fingerprint.
endif
if MTK_FINGERPRINT_SELECT = "FPSENSOR_JC_MICROARRAY_TEE"
config FINGERPRINT_FPSENSOR_JC_TEE
     bool "FPSENSOR_JC_TEE Fingerprint"
     default y
     ---help---
     FPSENSOR_JC_TEE fingerprint.
config FINGERPRINT_MICROARRAY_FP
	bool "MICROARRAY Fingerprint"
	default y
	---help---
	Microarray fingerprint.
endif

endmenu
```

## drivers/input/fingerprint/betterlife/Kconfig
```kconfig
config FINGERPRINT_BLESTECH
	tristate "blestech tee driver support"
	help
	  Say Y here if you want to support blestech tee  etc...
```

## drivers/misc/mediatek/psam/Kconfig
```kconfig
config MTK_PSAM
	tristate "MediaTek psam Support"
	---help---
	  This selects the psam connected to MediaTek chips.
	  If you want to use scanner support, say Y or M here.
	  If unsure, say N.
```

## drivers/misc/mediatek/scanner/Kconfig
```kconfig
config MTK_SCANNER
	tristate "MediaTek scanner Support"
	---help---
	  This selects the  scanner connected to MediaTek chips.
	  If you want to use scanner support, say Y or M here.
	  If unsure, say N.
	  Mediatek scanner module includes 1D/2D laser engines, RFID scanner etc.
```

## drivers/misc/mediatek/sensors-1.0/alsps/epl259x-new/Kconfig
```kconfig
config MTK_EPL259X_NEW
	bool "MTK_EPL259X_NEW for MediaTek package"
	default n
	help
	It support different type sensor
	in this platform. If this option
	is set, it will support ambient
	and light sensor MTK_EPL259X_NEW.
```

## drivers/misc/mediatek/sensors-1.0/alsps/ltr579-new/Kconfig
```kconfig
config MTK_LTR579_NEW
	bool "LTR579 for MediaTek package"
	default n
	help
	It support different type sensor
	in this platform. If this option
	is set, it will support ambient
	and light sensor LTR579.
```

## drivers/misc/mediatek/sensors-1.0/alsps/mn58xxx/Kconfig
```kconfig
config MTK_MN58XXX
	bool "MN58XXX for MediaTek package"
	default n
	help
	It support different type sensor
	in this platform. If this option
	is set, it will support ambient
	and light sensor MN58XXX.
```

## drivers/misc/mediatek/sensors-1.0/magnetometer/mmc3680x/Kconfig
```kconfig
config MTK_MMC3680X
	bool "mmc3630x for MediaTek package"
	default n
	help
	  It support different magnetometer sensor.
		  If this option is set,
	  It will support
		  MMC3630X magnetometer.
```

## drivers/misc/mediatek/sensors-1.0/magnetometer/mmc5603x/Kconfig
```kconfig
config MTK_MMC5603X
	bool "mmc5603x for MediaTek package"
	default n
	help
	  It support different magnetometer sensor.
		  If this option is set,
	  It will support
		  MMC5603X magnetometer.
```

## drivers/tty/serial/wk2xxx_i2c/Kconfig
```kconfig
config SERIAL_WK2132
  tristate "FE wk2132 i2c to uart Support"
    ---help---
      This selects the  wk2132 connected to MediaTek chips.
      If you want to use wk2132 support, say Y or M here.
      If unsure, say N.
```
